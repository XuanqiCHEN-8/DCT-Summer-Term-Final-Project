/* All code generated by Claude!!!

 * Plant device - auto travel-time calibration + dual limit switch, 4-step version
 * HW: Elegoo Mega2560 + JGB37-545 DC motor + BTS7960 driver
 *     + HC-SR04 ultrasonic sensor + dual limit switches (0% bend / 100% upright)
 *
 * Core idea:
 *   No manual travel time. On boot, motor runs 0% -> 100% once,
 *   millis() measures real duration as FULL_TRAVEL_TIME_MS, divided by 4 per step.
 *
 *   Limit switches are always the final safety net: any switch hit
 *   stops the motor immediately, regardless of timing estimate errors.
 *
 * Logic:
 *  - Auto calibration on boot: move to 0% (bend), then 100% (upright),
 *    record real travel time, then return to 0% as start state
 *  - Ultrasonic trigger = button press. order steps 25 (0->25->50->75->100),
 *    motor runs for "travel time / 4" per step, limit switches monitored always
 *  - Reaching a limit stops immediately, position force-synced to 0 or 100
 *  - Trigger while busy is queued, auto-continues after current step finishes
 *  - order sent to TouchDesigner over serial ("O,<order>\n")
 */

#include <Arduino.h>

// ------------------- Ultrasonic pins -------------------
const int PIN_TRIG = 23;
const int PIN_ECHO = 25;

// ------------------- Limit switch pins (0% bend / 100% upright) -------------------
const int PIN_LIMIT_LOW  = 24;
const int PIN_LIMIT_HIGH = 26;  // pin 22 unreliable on this board, using 26 instead

// ------------------- Motor driver pins -------------------
const int PIN_RPWM = 5;
const int PIN_LPWM = 6;
const int PIN_R_EN = 28;
const int PIN_L_EN = 32;

// ------------------- Direction: left=upright(+), right=bend(-) -------------------
const int DIR_UPRIGHT = 1;
const int DIR_BEND    = -1;

// ------------------- Ultrasonic trigger params -------------------
const float TRIGGER_DISTANCE_CM = 15.0;
const unsigned long SENSOR_READ_INTERVAL_MS = 60;
const unsigned long SENSOR_DEBOUNCE_MS = 150;

bool wasNear = false;
unsigned long lastSensorReadTime = 0;
unsigned long lastTriggerTime = 0;

// ------------------- Order state machine -------------------
const int   ORDER_STEP        = 25;
const int   ORDER_MAX         = 100;

int order = 0;
int currentPosition = 0;
int lastSentOrder = -1;

// ------------------- Queue -------------------
const int MAX_QUEUE = 4;
volatile int queuedPresses = 0;

// ------------------- Calibration speed (needs high torque for full travel) -------------------
const int CALIBRATION_SPEED = 140;
const unsigned long CALIBRATION_CHECK_INTERVAL_MS = 1;

// ------------------- Full travel time (auto measured) -------------------
unsigned long FULL_TRAVEL_TIME_MS = 0;
const unsigned long CALIBRATION_TIMEOUT_MS = 15000;

// ------------------- Idle decay params -------------------
const unsigned long IDLE_TIMEOUT_MS = 20000;  // start decay after 20s idle
const int MOTOR_PWM_DECAY = 90;
const unsigned long DECAY_RAMP_STEP_MS = 80;  // slower ramp than normal move
unsigned long lastDecayRampStepTime = 0;

bool decaying = false;
unsigned long lastActivityTime = 0;

// ------------------- Motion speed params (field verified) -------------------
const int MOTOR_PWM_MAX     = 110;
const int MOTOR_PWM_MIN     = 90;
const unsigned long RAMP_STEP_MS = 25;
const int RAMP_STEP_SIZE = 2;

const int SLOWDOWN_ZONE_PERCENT = 25;

// ------------------- Current applied PWM (soft start/stop tracking) -------------------
int currentAppliedSpeed = 0;
int currentAppliedDirection = 0;
int targetSpeedGoal = 0;
int targetDirectionGoal = 0;
unsigned long lastRampStepTime = 0;

// ------------------- Move state -------------------
bool motorMoving = false;
int  moveDirection = 0;
unsigned long moveStartTime = 0;
long moveTargetDurationMs = 0;
bool movingToFinalLimit = false; // final step: drive directly to limit

// ------------------- Limit switch edge state -------------------
bool wasAtLow = false;
bool wasAtHigh = false;

// ------------------- System state -------------------
bool calibrating = true;
bool faultState = false;

const unsigned long MOVE_TIMEOUT_MS = 15000;

void setup() {
  Serial.begin(115200);

  pinMode(PIN_TRIG, OUTPUT);
  digitalWrite(PIN_TRIG, LOW); // explicit init, avoid undefined state
  pinMode(PIN_ECHO, INPUT);
  pinMode(PIN_LIMIT_LOW, INPUT_PULLUP);
  pinMode(PIN_LIMIT_HIGH, INPUT_PULLUP);

  pinMode(PIN_RPWM, OUTPUT);
  pinMode(PIN_LPWM, OUTPUT);
  pinMode(PIN_R_EN, OUTPUT);
  pinMode(PIN_L_EN, OUTPUT);

  digitalWrite(PIN_R_EN, HIGH);
  digitalWrite(PIN_L_EN, HIGH);

  stopMotorImmediate();

  runCalibrationSequence();

  sendOrder(true);
}

void loop() {
  if (faultState) {
    stopMotorImmediate();
    return;
  }

  if (calibrating) return; // calibration runs blocking, handled separately

  handleLimitSwitches();
  handleUltrasonicTrigger();
  handleDecayTrigger();
  updateMotorMotion();
  processQueue();
  updateSpeedRamp();
  updateDecayRamp();

  if (order != lastSentOrder) {
    sendOrder(false);
  }
}

// ---------------- Decay trigger (20s idle -> slow return to bend) ----------------
// ------------------- Decay timeout safety -------------------
unsigned long decayStartTimestamp = 0;
const unsigned long DECAY_MAX_DURATION_MS = 20000; // max decay duration before fault

void handleDecayTrigger() {
  if (decaying || motorMoving || queuedPresses > 0) return;
  if (order <= 0) return;

  unsigned long idleElapsed = millis() - lastActivityTime;
  if (idleElapsed < IDLE_TIMEOUT_MS) return;

  decaying = true;
  decayStartTimestamp = millis();
  stopMotorImmediate(); // force clean stop before decay starts
  Serial.println("Decay started: slow continuous motion toward bend.");
  driveMotorRamped(DIR_BEND, MOTOR_PWM_DECAY);
}

void stopDecay() {
  decaying = false;
  stopMotorRamped();
  Serial.println("Decay interrupted by trigger.");
}

// ------------------- Decay visual order tracking (global, always resettable) -------------------
unsigned long decayVisualStart = 0;
int decayVisualStartOrder = 0;

// Decay uses a slower ramp (DECAY_RAMP_STEP_MS) and pushes order down over time
// for TD sync. Only active while decaying is true.
void updateDecayRamp() {
  if (!decaying) return;

  // Safety net: if decay runs too long without hitting the limit, fault out
  if (millis() - decayStartTimestamp > DECAY_MAX_DURATION_MS) {
    stopMotorImmediate();
    decaying = false;
    decayVisualStart = 0;
    Serial.println("FAULT: Decay did not reach bend limit within timeout. Check motor/mechanism.");
    faultState = true;
    return;
  }

  // Limit switch decides when decay ends, not a time estimate
  if (currentPosition <= 0) {
    decaying = false;
    decayVisualStart = 0;
    currentAppliedSpeed = 0;
    currentAppliedDirection = 0;
    targetSpeedGoal = 0;
    targetDirectionGoal = 0;
    return;
  }

  if (millis() - lastDecayRampStepTime < DECAY_RAMP_STEP_MS) return;
  lastDecayRampStepTime = millis();

  // Smaller step than normal RAMP_STEP_SIZE for a softer ramp
  if (currentAppliedSpeed == 0) {
    currentAppliedDirection = targetDirectionGoal;
    if (targetSpeedGoal > 0) {
      currentAppliedSpeed = 1;
      applyMotorOutput(currentAppliedDirection, currentAppliedSpeed);
    }
    return;
  }

  if (targetDirectionGoal != currentAppliedDirection) {
    // Direction change: stop immediately, no ramp-down tail,
    // next cycle picks up new direction from speed==0
    currentAppliedSpeed = 0;
    applyMotorOutput(currentAppliedDirection, 0);
  } else if (currentAppliedSpeed < targetSpeedGoal) {
    currentAppliedSpeed = min(targetSpeedGoal, currentAppliedSpeed + 1);
    applyMotorOutput(currentAppliedDirection, currentAppliedSpeed);
  }

  // Push order down over time for TD display sync
  if (decayVisualStart == 0) {
    decayVisualStart = millis();
    decayVisualStartOrder = order;
  }
  unsigned long elapsed = millis() - decayVisualStart;
  float percentReduced = (elapsed / (float)FULL_TRAVEL_TIME_MS) * 100.0;
  int newOrder = decayVisualStartOrder - (int)percentReduced;
  order = max(0, newOrder);

  if (order <= 0) {
    decayVisualStart = 0; // reset for next decay
  }
}

// ==================== Boot calibration: measure full travel time ====================

void runCalibrationSequence() {
  Serial.println("=== Auto-calibration starting ===");

  // Step 1: move to bend limit, starting point, not timed
  Serial.println("Step 1: moving to bend limit (starting point)...");
  driveToLimitBlocking(DIR_BEND, PIN_LIMIT_LOW, "bend");

  delay(300); // let mechanism settle before timing

  // Step 2: 0% to 100%, this is timed
  Serial.println("Step 2: measuring full travel time (bend -> upright)...");
  unsigned long travelStart = millis();
  driveToLimitBlocking(DIR_UPRIGHT, PIN_LIMIT_HIGH, "upright");
  unsigned long travelEnd = millis();

  FULL_TRAVEL_TIME_MS = travelEnd - travelStart;

  Serial.print("Measured FULL_TRAVEL_TIME_MS = ");
  Serial.print(FULL_TRAVEL_TIME_MS);
  Serial.println(" ms");

  delay(300);

  // Step 3: return to 0% as start state
  Serial.println("Step 3: returning to bend limit as starting state...");
  driveToLimitBlocking(DIR_BEND, PIN_LIMIT_LOW, "bend");

  currentPosition = 0;
  order = 0;
  calibrating = false;
  lastActivityTime = millis();

  // reset soft start/stop state so calibration use doesn't affect normal run
  currentAppliedSpeed = 0;
  currentAppliedDirection = 0;
  targetSpeedGoal = 0;
  targetDirectionGoal = 0;

  Serial.println("=== Auto-calibration complete. Ready for interaction. ===");
  Serial.print("Each step will take approximately ");
  Serial.print(FULL_TRAVEL_TIME_MS / 4);
  Serial.println(" ms.");
}

// Blocking drive to limit switch during calibration, faults on timeout.
// Priority: never overshoot. Soft ramp for a gentle start, short poll
// interval to keep stop-response latency minimal.
void driveToLimitBlocking(int direction, int limitPin, const char* label) {
  unsigned long startTime = millis();

  int wrongLimitPin = (limitPin == PIN_LIMIT_LOW) ? PIN_LIMIT_HIGH : PIN_LIMIT_LOW;
  const char* wrongLabel = (limitPin == PIN_LIMIT_LOW) ? "upright" : "bend";

  const unsigned long CROSS_CHECK_GRACE_MS = 500;
  const unsigned long LEAVE_CONFIRM_MS = 200; // must be stably off wrongLimitPin this long
  bool crossCheckArmed = false;
  unsigned long leaveStartTime = 0; // 0 = not started or was reset

  bool initiallyOnWrongLimit = (digitalRead(wrongLimitPin) == LOW);
  if (!initiallyOnWrongLimit) {
    // not on wrong limit at start, arm check immediately
    crossCheckArmed = true;
  }

  // clean init, don't reuse driveMotorRamped (that's for the main loop ramp,
  // mixing it into this blocking function causes state confusion)
  currentAppliedDirection = direction;
  currentAppliedSpeed = 0;
  applyMotorOutput(currentAppliedDirection, currentAppliedSpeed);

  Serial.print("DEBUG: direction=");
  Serial.print(direction);
  Serial.print(" CALIBRATION_SPEED=");
  Serial.print(CALIBRATION_SPEED);
  Serial.print(" limitPin initial=");
  Serial.println(digitalRead(limitPin));

  unsigned long lastCalibRampTime = millis();

  while (true) {
    if (digitalRead(limitPin) == LOW) {
      Serial.print("DEBUG: exiting loop because limitPin(");
      Serial.print(limitPin);
      Serial.println(") reads LOW");
      break;
    }

    if (!crossCheckArmed) {
      bool currentlyOnWrongLimit = (digitalRead(wrongLimitPin) == LOW);
      if (!currentlyOnWrongLimit) {
        // not on wrong limit: start or continue leave timer
        if (leaveStartTime == 0) {
          leaveStartTime = millis();
        } else if (millis() - leaveStartTime >= LEAVE_CONFIRM_MS) {
          crossCheckArmed = true;
        }
      } else {
        // back on wrong limit (was just a bounce), reset timer
        leaveStartTime = 0;
      }
    }

    if (crossCheckArmed && (millis() - startTime > CROSS_CHECK_GRACE_MS) && digitalRead(wrongLimitPin) == LOW) {
      Serial.print("DEBUG: cross-check triggered. wrongLimitPin(");
      Serial.print(wrongLimitPin);
      Serial.println(") reads LOW");
      stopMotorImmediate();
      Serial.print("FAULT: Expected ");
      Serial.print(label);
      Serial.print(" limit but triggered ");
      Serial.print(wrongLabel);
      Serial.println(" limit instead. Check motor direction wiring.");
      faultState = true;
      return;
    }

    if (millis() - startTime > CALIBRATION_TIMEOUT_MS) {
      stopMotorImmediate();
      Serial.print("FAULT: Calibration timeout waiting for ");
      Serial.print(label);
      Serial.println(" limit switch. Check wiring.");
      faultState = true;
      return;
    }

    if (millis() - lastCalibRampTime >= DECAY_RAMP_STEP_MS) {
      lastCalibRampTime = millis();
      if (currentAppliedSpeed < CALIBRATION_SPEED) {
        currentAppliedSpeed = min(CALIBRATION_SPEED, currentAppliedSpeed + 1);
        applyMotorOutput(currentAppliedDirection, currentAppliedSpeed);
      }
    }

    delayMicroseconds(500);
  }

  stopMotorImmediate();
  Serial.print("Reached ");
  Serial.print(label);
  Serial.println(" limit during calibration.");
}

// ---------------- Limit switches: top-priority safety net, both ends ----------------
void handleLimitSwitches() {
  bool atLow  = (digitalRead(PIN_LIMIT_LOW)  == LOW);
  bool atHigh = (digitalRead(PIN_LIMIT_HIGH) == LOW);

  // rising edge: stop immediately the instant it's hit, any state
  if (atLow && !wasAtLow) {
    stopMotorImmediate();
    currentPosition = 0;
    order = 0;
    motorMoving = false;
    decaying = false;
    decayVisualStart = 0;
    currentAppliedSpeed = 0;
    currentAppliedDirection = 0;
    targetSpeedGoal = 0;
    targetDirectionGoal = 0;
    Serial.println("Reached bend limit. Stopped immediately.");
  }
  if (atHigh && !wasAtHigh) {
    stopMotorImmediate();

    if (decaying) {
      // Correction: decay should go toward bend but hit upright instead,
      // direction must be wrong. Don't treat as "reached 100%",
      // reverse toward bend immediately so decay always completes.
      Serial.println("WARNING: Decay unexpectedly hit upright limit. Reversing toward bend limit.");
      currentAppliedSpeed = 0;
      currentAppliedDirection = 0;
      targetSpeedGoal = 0;
      targetDirectionGoal = 0;
      driveMotorRamped(DIR_BEND, MOTOR_PWM_DECAY);
    } else {
      currentPosition = 100;
      order = 100;
      motorMoving = false;
      movingToFinalLimit = false;
      currentAppliedSpeed = 0;
      currentAppliedDirection = 0;
      targetSpeedGoal = 0;
      targetDirectionGoal = 0;
      Serial.println("Reached upright limit. Stopped immediately.");
    }
  }

  // ongoing protection: only block continuing toward this limit's direction
  if (atLow && targetDirectionGoal == DIR_BEND) {
    stopMotorImmediate();
  }
  if (atHigh && targetDirectionGoal == DIR_UPRIGHT) {
    stopMotorImmediate();
  }

  wasAtLow = atLow;
  wasAtHigh = atHigh;
}

// ---------------- Ultrasonic distance read ----------------
float readDistanceCm() {
  digitalWrite(PIN_TRIG, LOW);
  delayMicroseconds(2);
  digitalWrite(PIN_TRIG, HIGH);
  delayMicroseconds(10);
  digitalWrite(PIN_TRIG, LOW);

  long duration = pulseIn(PIN_ECHO, HIGH, 30000);
  if (duration == 0) {
    return 999.0;
  }
  return duration * 0.0343 / 2.0;
}

// ---------------- Ultrasonic edge trigger ----------------
void handleUltrasonicTrigger() {
  if (millis() - lastSensorReadTime < SENSOR_READ_INTERVAL_MS) return;
  lastSensorReadTime = millis();

  float distance = readDistanceCm();
  bool isNear = (distance < TRIGGER_DISTANCE_CM);

  if (isNear && !wasNear) {
    if (millis() - lastTriggerTime > SENSOR_DEBOUNCE_MS) {
      onSensorTrigger();
      lastTriggerTime = millis();
    }
  }

  wasNear = isNear;
}

void onSensorTrigger() {
  lastActivityTime = millis();

  if (decaying) {
    stopDecay();
  }

  if (order >= ORDER_MAX && queuedPresses == 0) {
    return;
  }

  if (!motorMoving) {
    advanceOneStep();
  } else {
    if (queuedPresses < MAX_QUEUE) {
      queuedPresses++;
      Serial.print("Queued trigger. Queue length: ");
      Serial.println(queuedPresses);
    }
  }
}

void advanceOneStep() {
  if (order < ORDER_MAX) {
    int nextOrder = min(order + ORDER_STEP, ORDER_MAX);
    if (nextOrder >= ORDER_MAX) {
      // final step: no time estimate, drive continuously until upright
      // limit is hit, so 100% is always physically exact
      order = ORDER_MAX;
      movingToFinalLimit = true;
      motorMoving = true;
      moveDirection = DIR_UPRIGHT;
      driveMotorRamped(DIR_UPRIGHT, MOTOR_PWM_MIN); // lower speed, less impact
      Serial.println("Final step: driving directly to upright limit switch.");
    } else {
      order = nextOrder;
      startMoveToTarget(order);
    }
  }
}

void processQueue() {
  static bool wasMoving = false;

  bool justBecameIdle = (wasMoving && !motorMoving);
  wasMoving = motorMoving;

  if (justBecameIdle && queuedPresses > 0 && order < ORDER_MAX) {
    queuedPresses--;
    advanceOneStep();
    Serial.print("Processing queued trigger. Remaining queue: ");
    Serial.println(queuedPresses);
  }

  if (order >= ORDER_MAX && queuedPresses > 0) {
    queuedPresses = 0;
  }
}

// ---------------- Serial output to TouchDesigner ----------------
void sendOrder(bool force) {
  if (!force && order == lastSentOrder) return;
  Serial.print("O,");
  Serial.println(order);
  lastSentOrder = order;
}

// ==================== Time-proportional control (4-step, calibrated) ====================

// ------------------- Step duration correction factor -------------------
// Field finding: theoretical step time (FULL_TRAVEL_TIME_MS/4) overshoots
// (2 steps reach top instead of 4). Calibration is one long continuous
// high-speed run; each step is short with accel/decel, so average speed
// differs. This factor corrects step duration directly.
float STEP_DURATION_CORRECTION = 0.55; // tune on site: too few steps to
                                         // top -> decrease (e.g. 0.45);
                                         // too many -> increase (e.g. 0.65)

void startMoveToTarget(int targetOrder) {
  int deltaPercent = targetOrder - currentPosition;
  if (deltaPercent == 0) return;

  moveDirection = (deltaPercent > 0) ? DIR_UPRIGHT : DIR_BEND;
  long durationMs = (long)(abs(deltaPercent) / 100.0 * FULL_TRAVEL_TIME_MS * STEP_DURATION_CORRECTION);

  moveTargetDurationMs = durationMs;
  moveStartTime = millis();
  motorMoving = true;
}

void updateMotorMotion() {
  if (decaying) return; // never run during decay, avoids racing updateDecayRamp()
  if (!motorMoving) return;

  unsigned long elapsed = millis() - moveStartTime;

  if (elapsed > MOVE_TIMEOUT_MS) {
    triggerFault("Move timeout - unexpected, limit switch should have caught this");
    return;
  }

  if (movingToFinalLimit) {
    // final step: no duration check, drive until upright limit is hit.
    // Can't know distance in advance, so use lower constant speed
    // to reduce impact on the limit switch.
    driveMotorRamped(DIR_UPRIGHT, MOTOR_PWM_MIN);
    return;
  }

  if (elapsed >= (unsigned long)moveTargetDurationMs) {
    // duration reached: speed should already be near zero from decel below,
    // this stop is just a clean confirmation, no noticeable jolt
    stopMotorImmediate();
    currentPosition = order;
    motorMoving = false;
    return;
  }

  long remaining = moveTargetDurationMs - elapsed;
  // Key fix: slowdown zone must scale with this step's duration, not the
  // full travel time. With 25% of FULL_TRAVEL_TIME_MS, a short step would
  // spend almost its entire duration decelerating, leaving no real
  // full-speed time and causing much smaller actual rotation than expected.
  long slowZoneMs = (long)(0.20 * moveTargetDurationMs);
  slowZoneMs = max(slowZoneMs, 80L); // keep at least 80ms for a soft finish

  if (remaining < slowZoneMs) {
    // decel zone: linearly ramp speed to 0 so the motor is truly
    // stopped by the time duration elapses, not still spinning
    int decelSpeed = (int)((float)remaining / slowZoneMs * MOTOR_PWM_MAX);
    decelSpeed = constrain(decelSpeed, 0, MOTOR_PWM_MAX);
    driveMotorRamped(moveDirection, decelSpeed);
  } else {
    driveMotorRamped(moveDirection, MOTOR_PWM_MAX);
  }
}

// ---------------- Fault handling ----------------
void triggerFault(const char* reason) {
  stopMotorImmediate();
  faultState = true;
  Serial.print("FAULT: ");
  Serial.println(reason);
  Serial.println("Motor locked. Power cycle required after inspection.");
}

// ==================== Soft start/stop core ====================

void driveMotorRamped(int direction, int speed) {
  targetDirectionGoal = direction;
  targetSpeedGoal = constrain(speed, 0, MOTOR_PWM_MAX);
}

void stopMotorRamped() {
  targetSpeedGoal = 0;
}

void updateSpeedRamp() {
  if (decaying) return; // decay owns the motor via updateDecayRamp()

  if (millis() - lastRampStepTime < RAMP_STEP_MS) return;
  lastRampStepTime = millis();

  if (currentAppliedSpeed == 0) {
    currentAppliedDirection = targetDirectionGoal;
    if (targetSpeedGoal > 0) {
      currentAppliedSpeed = min(targetSpeedGoal, RAMP_STEP_SIZE);
      applyMotorOutput(currentAppliedDirection, currentAppliedSpeed);
    }
    return;
  }

  if (targetDirectionGoal != currentAppliedDirection) {
    currentAppliedSpeed = max(0, currentAppliedSpeed - RAMP_STEP_SIZE);
    applyMotorOutput(currentAppliedDirection, currentAppliedSpeed);
    return;
  }

  if (currentAppliedSpeed < targetSpeedGoal) {
    currentAppliedSpeed = min(targetSpeedGoal, currentAppliedSpeed + RAMP_STEP_SIZE);
  } else if (currentAppliedSpeed > targetSpeedGoal) {
    currentAppliedSpeed = max(targetSpeedGoal, currentAppliedSpeed - RAMP_STEP_SIZE);
  }

  applyMotorOutput(currentAppliedDirection, currentAppliedSpeed);
}

// ---------------- BTS7960 low-level drive ----------------
void applyMotorOutput(int direction, int pwmSpeed) {
  if (pwmSpeed <= 0) {
    analogWrite(PIN_RPWM, 0);
    analogWrite(PIN_LPWM, 0);
    return;
  }
  if (direction == DIR_UPRIGHT) {
    analogWrite(PIN_RPWM, pwmSpeed);
    analogWrite(PIN_LPWM, 0);
  } else if (direction == DIR_BEND) {
    analogWrite(PIN_RPWM, 0);
    analogWrite(PIN_LPWM, pwmSpeed);
  }
}

void stopMotorImmediate() {
  analogWrite(PIN_RPWM, 0);
  analogWrite(PIN_LPWM, 0);
  currentAppliedSpeed = 0;
  currentAppliedDirection = 0;  // must clear, stale direction breaks limit checks
  targetSpeedGoal = 0;
  targetDirectionGoal = 0;      // same as above
}
